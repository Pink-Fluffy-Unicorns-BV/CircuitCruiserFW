## sdkconfig.defaults
```kconfig
CONFIG_EXAMPLE_WEB_DEPLOY_SF=y
CONFIG_EXAMPLE_MDNS_HOST_NAME="circuit-cruiser"
CONFIG_EXAMPLE_HOST_PATH_TO_MOUNT="PATH-TO-WEB-DIST_DIR"
CONFIG_EXAMPLE_WEB_MOUNT_POINT="/www"

CONFIG_HTTPD_MAX_REQ_HDR_LEN=1024
CONFIG_SPIFFS_OBJ_NAME_LEN=64
CONFIG_FATFS_LFN_HEAP=y
CONFIG_ESPTOOLPY_FLASHSIZE_8MB=y
CONFIG_PARTITION_TABLE_CUSTOM=y
CONFIG_PARTITION_TABLE_CUSTOM_FILENAME="partitions.csv"
CONFIG_PARTITION_TABLE_FILENAME="partitions.csv"

CONFIG_ESP_CONSOLE_USB_SERIAL_JTAG=y
CONFIG_INT_WDT_TIMEOUT_MS=3000

CONFIG_WS_TRANSPORT=y
CONFIG_WS_BUFFER_SIZE=1024
```
